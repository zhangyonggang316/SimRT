/******************************************************************************
* ASAP2 file: x280_canfd_loopback.a2l
* Academic License - for use in teaching, academic research, and meeting
* course requirements at degree granting institutions only. Not for
* government, commercial, or other organizational use.
* Code generation for model "x280_canfd_loopback".
* Model version : 1.7
* Simulink Coder version : 24.2 (R2024b) 21-Jun-2024
* C source code generated on : Sat Sep 19 01:17:28 2026
* Target selection: ert.tlc
* Embedded hardware selection: Intel->x86-64 (Linux 64)
* Code generation objectives: Unspecified
* Validation result: Not run
* (add additional file header information here)
******************************************************************************/ ASAP2_VERSION 1 71
/* Version 1.71 */
/begin PROJECT ProjectName "Project Comment Goes Here"
/begin HEADER "Header Comments go here" /end HEADER
/begin MODULE ModuleName "Module Comment Goes Here"
/begin IF_DATA XCP
 /begin PROTOCOL_LAYER 0x0100 0x03E8 0x00C8 0x0000 0x0000 0x0000 0x0000 0x0000 0xFF 0x01FC BYTE_ORDER_MSB_LAST ADDRESS_GRANULARITY_BYTE OPTIONAL_CMD ALLOC_ODT_ENTRY OPTIONAL_CMD ALLOC_ODT OPTIONAL_CMD ALLOC_DAQ OPTIONAL_CMD FREE_DAQ OPTIONAL_CMD GET_DAQ_RESOLUTION_INFO OPTIONAL_CMD GET_DAQ_PROCESSOR_INFO OPTIONAL_CMD START_STOP_SYNCH OPTIONAL_CMD START_STOP_DAQ_LIST OPTIONAL_CMD SET_DAQ_LIST_MODE OPTIONAL_CMD WRITE_DAQ OPTIONAL_CMD SET_DAQ_PTR OPTIONAL_CMD SHORT_DOWNLOAD OPTIONAL_CMD DOWNLOAD OPTIONAL_CMD SHORT_UPLOAD OPTIONAL_CMD UPLOAD OPTIONAL_CMD SET_MTA /end PROTOCOL_LAYER
 /begin DAQ DYNAMIC 0xFFFF 0x0080 0x00 OPTIMISATION_TYPE_DEFAULT ADDRESS_EXTENSION_FREE IDENTIFICATION_FIELD_TYPE_ABSOLUTE GRANULARITY_ODT_ENTRY_SIZE_DAQ_BYTE 0xFF NO_OVERLOAD_INDICATION /begin TIMESTAMP_SUPPORTED 0x0001 SIZE_DWORD UNIT_1US /end TIMESTAMP_SUPPORTED /begin EVENT "1 ms" "1 ms" 0x0000 DAQ 0xFF 0x01 0x06 0x00 /end EVENT /end DAQ
 /begin XCP_ON_UDP_IP 0x0100 0x453D ADDRESS "192.168.219.86" /end XCP_ON_UDP_IP
/end IF_DATA
/begin MOD_PAR "MOD PAR Comment Goes Here" /end MOD_PAR
/begin MOD_COMMON "Mod Common Comment Here" BYTE_ORDER MSB_LAST ALIGNMENT_BYTE 1 ALIGNMENT_WORD 2 ALIGNMENT_LONG 4 ALIGNMENT_FLOAT32_IEEE 4 ALIGNMENT_FLOAT64_IEEE 8 ALIGNMENT_INT64 8 /end MOD_COMMON
/begin CHARACTERISTIC x280_canfd_loopback_P.CAN1_Payload_Value "" VAL_BLK 0x00419301 Record_UBYTE 0 x280_canfd_loopback_CM_uint8 0 255 MATRIX_DIM 64 1 /end CHARACTERISTIC
/begin CHARACTERISTIC x280_canfd_loopback_P.CAN2_Payload_Value "" VAL_BLK 0x00419341 Record_UBYTE 0 x280_canfd_loopback_CM_uint8 0 255 MATRIX_DIM 64 1 /end CHARACTERISTIC
/begin CHARACTERISTIC x280_canfd_loopback_P.Transmit_Enable_Value "" VALUE 0x00419300 Record_BOOLEAN 0 x280_canfd_loopback_CM_logical 0 1 /end CHARACTERISTIC
/begin MEASUREMENT x280_canfd_loopback_B.CAN1_Data "" UBYTE x280_canfd_loopback_CM_uint8 0 0 0 255 LAYOUT COLUMN_DIR MATRIX_DIM 64 ECU_ADDRESS 0x0052FEB8 /end MEASUREMENT
/begin MEASUREMENT x280_canfd_loopback_B.CAN1_ID "" ULONG x280_canfd_loopback_CM_uint32 0 0 0 4294967295 ECU_ADDRESS 0x0052FEA0 /end MEASUREMENT
/begin MEASUREMENT x280_canfd_loopback_B.CAN1_RxStatus "" SLONG x280_canfd_loopback_CM_int32 0 0 -2147483648 2147483647 ECU_ADDRESS 0x0052FEB4 /end MEASUREMENT
/begin MEASUREMENT x280_canfd_loopback_B.CAN1_TxStatus "" SLONG x280_canfd_loopback_CM_int32 0 0 -2147483648 2147483647 ECU_ADDRESS 0x0052FEAC /end MEASUREMENT
/begin MEASUREMENT x280_canfd_loopback_B.CAN1_Valid "" UBYTE x280_canfd_loopback_CM_logical 0 0 0 1 ECU_ADDRESS 0x0052FF39 /end MEASUREMENT
/begin MEASUREMENT x280_canfd_loopback_B.CAN2_Data "" UBYTE x280_canfd_loopback_CM_uint8 0 0 0 255 LAYOUT COLUMN_DIR MATRIX_DIM 64 ECU_ADDRESS 0x0052FEF8 /end MEASUREMENT
/begin MEASUREMENT x280_canfd_loopback_B.CAN2_ID "" ULONG x280_canfd_loopback_CM_uint32 0 0 0 4294967295 ECU_ADDRESS 0x0052FEA4 /end MEASUREMENT
/begin MEASUREMENT x280_canfd_loopback_B.CAN2_RxStatus "" SLONG x280_canfd_loopback_CM_int32 0 0 -2147483648 2147483647 ECU_ADDRESS 0x0052FEB0 /end MEASUREMENT
/begin MEASUREMENT x280_canfd_loopback_B.CAN2_TxStatus "" SLONG x280_canfd_loopback_CM_int32 0 0 -2147483648 2147483647 ECU_ADDRESS 0x0052FEA8 /end MEASUREMENT
/begin MEASUREMENT x280_canfd_loopback_B.CAN2_Valid "" UBYTE x280_canfd_loopback_CM_logical 0 0 0 1 ECU_ADDRESS 0x0052FF38 /end MEASUREMENT
/begin MEASUREMENT x280_canfd_loopback_B.Pack_CAN1.BRS "" UBYTE x280_canfd_loopback_CM_uint8 0 0 0 255 ECU_ADDRESS 0x0052FD45 /end MEASUREMENT
/begin MEASUREMENT x280_canfd_loopback_B.Pack_CAN1.DLC "" UBYTE x280_canfd_loopback_CM_uint8 0 0 0 255 ECU_ADDRESS 0x0052FD47 /end MEASUREMENT
/begin MEASUREMENT x280_canfd_loopback_B.Pack_CAN1.Data "" UBYTE x280_canfd_loopback_CM_uint8 0 0 0 255 LAYOUT COLUMN_DIR MATRIX_DIM 64 ECU_ADDRESS 0x0052FD58 /end MEASUREMENT
/begin MEASUREMENT x280_canfd_loopback_B.Pack_CAN1.ESI "" UBYTE x280_canfd_loopback_CM_uint8 0 0 0 255 ECU_ADDRESS 0x0052FD46 /end MEASUREMENT
/begin MEASUREMENT x280_canfd_loopback_B.Pack_CAN1.Error "" UBYTE x280_canfd_loopback_CM_uint8 0 0 0 255 ECU_ADDRESS 0x0052FD44 /end MEASUREMENT
/begin MEASUREMENT x280_canfd_loopback_B.Pack_CAN1.Extended "" UBYTE x280_canfd_loopback_CM_uint8 0 0 0 255 ECU_ADDRESS 0x0052FD41 /end MEASUREMENT
/begin MEASUREMENT x280_canfd_loopback_B.Pack_CAN1.ID "" ULONG x280_canfd_loopback_CM_uint32 0 0 0 4294967295 ECU_ADDRESS 0x0052FD48 /end MEASUREMENT
/begin MEASUREMENT x280_canfd_loopback_B.Pack_CAN1.Length "" UBYTE x280_canfd_loopback_CM_uint8 0 0 0 255 ECU_ADDRESS 0x0052FD42 /end MEASUREMENT
/begin MEASUREMENT x280_canfd_loopback_B.Pack_CAN1.ProtocolMode "" UBYTE x280_canfd_loopback_CM_uint8 0 0 0 255 ECU_ADDRESS 0x0052FD40 /end MEASUREMENT
/begin MEASUREMENT x280_canfd_loopback_B.Pack_CAN1.Remote "" UBYTE x280_canfd_loopback_CM_uint8 0 0 0 255 ECU_ADDRESS 0x0052FD43 /end MEASUREMENT
/begin MEASUREMENT x280_canfd_loopback_B.Pack_CAN1.Reserved "" ULONG x280_canfd_loopback_CM_uint32 0 0 0 4294967295 ECU_ADDRESS 0x0052FD4C /end MEASUREMENT
/begin MEASUREMENT x280_canfd_loopback_B.Pack_CAN1.Timestamp "" FLOAT64_IEEE x280_canfd_loopback_CM_double 0 0 -1.7E+308 1.7E+308 ECU_ADDRESS 0x0052FD50 /end MEASUREMENT
/begin MEASUREMENT x280_canfd_loopback_B.Pack_CAN2.BRS "" UBYTE x280_canfd_loopback_CM_uint8 0 0 0 255 ECU_ADDRESS 0x0052FD9D /end MEASUREMENT
/begin MEASUREMENT x280_canfd_loopback_B.Pack_CAN2.DLC "" UBYTE x280_canfd_loopback_CM_uint8 0 0 0 255 ECU_ADDRESS 0x0052FD9F /end MEASUREMENT
/begin MEASUREMENT x280_canfd_loopback_B.Pack_CAN2.Data "" UBYTE x280_canfd_loopback_CM_uint8 0 0 0 255 LAYOUT COLUMN_DIR MATRIX_DIM 64 ECU_ADDRESS 0x0052FDB0 /end MEASUREMENT
/begin MEASUREMENT x280_canfd_loopback_B.Pack_CAN2.ESI "" UBYTE x280_canfd_loopback_CM_uint8 0 0 0 255 ECU_ADDRESS 0x0052FD9E /end MEASUREMENT
/begin MEASUREMENT x280_canfd_loopback_B.Pack_CAN2.Error "" UBYTE x280_canfd_loopback_CM_uint8 0 0 0 255 ECU_ADDRESS 0x0052FD9C /end MEASUREMENT
/begin MEASUREMENT x280_canfd_loopback_B.Pack_CAN2.Extended "" UBYTE x280_canfd_loopback_CM_uint8 0 0 0 255 ECU_ADDRESS 0x0052FD99 /end MEASUREMENT
/begin MEASUREMENT x280_canfd_loopback_B.Pack_CAN2.ID "" ULONG x280_canfd_loopback_CM_uint32 0 0 0 4294967295 ECU_ADDRESS 0x0052FDA0 /end MEASUREMENT
/begin MEASUREMENT x280_canfd_loopback_B.Pack_CAN2.Length "" UBYTE x280_canfd_loopback_CM_uint8 0 0 0 255 ECU_ADDRESS 0x0052FD9A /end MEASUREMENT
/begin MEASUREMENT x280_canfd_loopback_B.Pack_CAN2.ProtocolMode "" UBYTE x280_canfd_loopback_CM_uint8 0 0 0 255 ECU_ADDRESS 0x0052FD98 /end MEASUREMENT
/begin MEASUREMENT x280_canfd_loopback_B.Pack_CAN2.Remote "" UBYTE x280_canfd_loopback_CM_uint8 0 0 0 255 ECU_ADDRESS 0x0052FD9B /end MEASUREMENT
/begin MEASUREMENT x280_canfd_loopback_B.Pack_CAN2.Reserved "" ULONG x280_canfd_loopback_CM_uint32 0 0 0 4294967295 ECU_ADDRESS 0x0052FDA4 /end MEASUREMENT
/begin MEASUREMENT x280_canfd_loopback_B.Pack_CAN2.Timestamp "" FLOAT64_IEEE x280_canfd_loopback_CM_double 0 0 -1.7E+308 1.7E+308 ECU_ADDRESS 0x0052FDA8 /end MEASUREMENT
/begin MEASUREMENT x280_canfd_loopback_B.Receive_CAN1_o1.BRS "" UBYTE x280_canfd_loopback_CM_uint8 0 0 0 255 ECU_ADDRESS 0x0052FE4D /end MEASUREMENT
/begin MEASUREMENT x280_canfd_loopback_B.Receive_CAN1_o1.DLC "" UBYTE x280_canfd_loopback_CM_uint8 0 0 0 255 ECU_ADDRESS 0x0052FE4F /end MEASUREMENT
/begin MEASUREMENT x280_canfd_loopback_B.Receive_CAN1_o1.Data "" UBYTE x280_canfd_loopback_CM_uint8 0 0 0 255 LAYOUT COLUMN_DIR MATRIX_DIM 64 ECU_ADDRESS 0x0052FE60 /end MEASUREMENT
/begin MEASUREMENT x280_canfd_loopback_B.Receive_CAN1_o1.ESI "" UBYTE x280_canfd_loopback_CM_uint8 0 0 0 255 ECU_ADDRESS 0x0052FE4E /end MEASUREMENT
/begin MEASUREMENT x280_canfd_loopback_B.Receive_CAN1_o1.Error "" UBYTE x280_canfd_loopback_CM_uint8 0 0 0 255 ECU_ADDRESS 0x0052FE4C /end MEASUREMENT
/begin MEASUREMENT x280_canfd_loopback_B.Receive_CAN1_o1.Extended "" UBYTE x280_canfd_loopback_CM_uint8 0 0 0 255 ECU_ADDRESS 0x0052FE49 /end MEASUREMENT
/begin MEASUREMENT x280_canfd_loopback_B.Receive_CAN1_o1.ID "" ULONG x280_canfd_loopback_CM_uint32 0 0 0 4294967295 ECU_ADDRESS 0x0052FE50 /end MEASUREMENT
/begin MEASUREMENT x280_canfd_loopback_B.Receive_CAN1_o1.Length "" UBYTE x280_canfd_loopback_CM_uint8 0 0 0 255 ECU_ADDRESS 0x0052FE4A /end MEASUREMENT
/begin MEASUREMENT x280_canfd_loopback_B.Receive_CAN1_o1.ProtocolMode "" UBYTE x280_canfd_loopback_CM_uint8 0 0 0 255 ECU_ADDRESS 0x0052FE48 /end MEASUREMENT
/begin MEASUREMENT x280_canfd_loopback_B.Receive_CAN1_o1.Remote "" UBYTE x280_canfd_loopback_CM_uint8 0 0 0 255 ECU_ADDRESS 0x0052FE4B /end MEASUREMENT
/begin MEASUREMENT x280_canfd_loopback_B.Receive_CAN1_o1.Reserved "" ULONG x280_canfd_loopback_CM_uint32 0 0 0 4294967295 ECU_ADDRESS 0x0052FE54 /end MEASUREMENT
/begin MEASUREMENT x280_canfd_loopback_B.Receive_CAN1_o1.Timestamp "" FLOAT64_IEEE x280_canfd_loopback_CM_double 0 0 -1.7E+308 1.7E+308 ECU_ADDRESS 0x0052FE58 /end MEASUREMENT
/begin MEASUREMENT x280_canfd_loopback_B.Receive_CAN2_o1.BRS "" UBYTE x280_canfd_loopback_CM_uint8 0 0 0 255 ECU_ADDRESS 0x0052FDF5 /end MEASUREMENT
/begin MEASUREMENT x280_canfd_loopback_B.Receive_CAN2_o1.DLC "" UBYTE x280_canfd_loopback_CM_uint8 0 0 0 255 ECU_ADDRESS 0x0052FDF7 /end MEASUREMENT
/begin MEASUREMENT x280_canfd_loopback_B.Receive_CAN2_o1.Data "" UBYTE x280_canfd_loopback_CM_uint8 0 0 0 255 LAYOUT COLUMN_DIR MATRIX_DIM 64 ECU_ADDRESS 0x0052FE08 /end MEASUREMENT
/begin MEASUREMENT x280_canfd_loopback_B.Receive_CAN2_o1.ESI "" UBYTE x280_canfd_loopback_CM_uint8 0 0 0 255 ECU_ADDRESS 0x0052FDF6 /end MEASUREMENT
/begin MEASUREMENT x280_canfd_loopback_B.Receive_CAN2_o1.Error "" UBYTE x280_canfd_loopback_CM_uint8 0 0 0 255 ECU_ADDRESS 0x0052FDF4 /end MEASUREMENT
/begin MEASUREMENT x280_canfd_loopback_B.Receive_CAN2_o1.Extended "" UBYTE x280_canfd_loopback_CM_uint8 0 0 0 255 ECU_ADDRESS 0x0052FDF1 /end MEASUREMENT
/begin MEASUREMENT x280_canfd_loopback_B.Receive_CAN2_o1.ID "" ULONG x280_canfd_loopback_CM_uint32 0 0 0 4294967295 ECU_ADDRESS 0x0052FDF8 /end MEASUREMENT
/begin MEASUREMENT x280_canfd_loopback_B.Receive_CAN2_o1.Length "" UBYTE x280_canfd_loopback_CM_uint8 0 0 0 255 ECU_ADDRESS 0x0052FDF2 /end MEASUREMENT
/begin MEASUREMENT x280_canfd_loopback_B.Receive_CAN2_o1.ProtocolMode "" UBYTE x280_canfd_loopback_CM_uint8 0 0 0 255 ECU_ADDRESS 0x0052FDF0 /end MEASUREMENT
/begin MEASUREMENT x280_canfd_loopback_B.Receive_CAN2_o1.Remote "" UBYTE x280_canfd_loopback_CM_uint8 0 0 0 255 ECU_ADDRESS 0x0052FDF3 /end MEASUREMENT
/begin MEASUREMENT x280_canfd_loopback_B.Receive_CAN2_o1.Reserved "" ULONG x280_canfd_loopback_CM_uint32 0 0 0 4294967295 ECU_ADDRESS 0x0052FDFC /end MEASUREMENT
/begin MEASUREMENT x280_canfd_loopback_B.Receive_CAN2_o1.Timestamp "" FLOAT64_IEEE x280_canfd_loopback_CM_double 0 0 -1.7E+308 1.7E+308 ECU_ADDRESS 0x0052FE00 /end MEASUREMENT
/begin MEASUREMENT x280_canfd_loopback_DW.Unpack_CAN1_ModeSignalID "" SLONG x280_canfd_loopback_CM_int_T 0 0 -2147483648 2147483647 ECU_ADDRESS 0x0052FD20 /end MEASUREMENT
/begin MEASUREMENT x280_canfd_loopback_DW.Unpack_CAN1_StatusPortID "" SLONG x280_canfd_loopback_CM_int_T 0 0 -2147483648 2147483647 ECU_ADDRESS 0x0052FD24 /end MEASUREMENT
/begin MEASUREMENT x280_canfd_loopback_DW.Unpack_CAN2_ModeSignalID "" SLONG x280_canfd_loopback_CM_int_T 0 0 -2147483648 2147483647 ECU_ADDRESS 0x0052FD28 /end MEASUREMENT
/begin MEASUREMENT x280_canfd_loopback_DW.Unpack_CAN2_StatusPortID "" SLONG x280_canfd_loopback_CM_int_T 0 0 -2147483648 2147483647 ECU_ADDRESS 0x0052FD2C /end MEASUREMENT
/begin MEASUREMENT x280_canfd_loopback_Y.CAN1_Data "" UBYTE x280_canfd_loopback_CM_uint8 0 0 0 255 LAYOUT COLUMN_DIR MATRIX_DIM 64 ECU_ADDRESS 0x0052FF48 /end MEASUREMENT
/begin MEASUREMENT x280_canfd_loopback_Y.CAN1_ID "" ULONG x280_canfd_loopback_CM_uint32 0 0 0 4294967295 ECU_ADDRESS 0x0052FF88 /end MEASUREMENT
/begin MEASUREMENT x280_canfd_loopback_Y.CAN1_RxStatus "" SLONG x280_canfd_loopback_CM_int32 0 0 -2147483648 2147483647 ECU_ADDRESS 0x0052FF90 /end MEASUREMENT
/begin MEASUREMENT x280_canfd_loopback_Y.CAN1_TxStatus "" SLONG x280_canfd_loopback_CM_int32 0 0 -2147483648 2147483647 ECU_ADDRESS 0x0052FF40 /end MEASUREMENT
/begin MEASUREMENT x280_canfd_loopback_Y.CAN1_Valid "" UBYTE x280_canfd_loopback_CM_logical 0 0 0 1 ECU_ADDRESS 0x0052FF8C /end MEASUREMENT
/begin MEASUREMENT x280_canfd_loopback_Y.CAN2_Data "" UBYTE x280_canfd_loopback_CM_uint8 0 0 0 255 LAYOUT COLUMN_DIR MATRIX_DIM 64 ECU_ADDRESS 0x0052FF94 /end MEASUREMENT
/begin MEASUREMENT x280_canfd_loopback_Y.CAN2_ID "" ULONG x280_canfd_loopback_CM_uint32 0 0 0 4294967295 ECU_ADDRESS 0x0052FFD4 /end MEASUREMENT
/begin MEASUREMENT x280_canfd_loopback_Y.CAN2_RxStatus "" SLONG x280_canfd_loopback_CM_int32 0 0 -2147483648 2147483647 ECU_ADDRESS 0x0052FFDC /end MEASUREMENT
/begin MEASUREMENT x280_canfd_loopback_Y.CAN2_TxStatus "" SLONG x280_canfd_loopback_CM_int32 0 0 -2147483648 2147483647 ECU_ADDRESS 0x0052FF44 /end MEASUREMENT
/begin MEASUREMENT x280_canfd_loopback_Y.CAN2_Valid "" UBYTE x280_canfd_loopback_CM_logical 0 0 0 1 ECU_ADDRESS 0x0052FFD8 /end MEASUREMENT
/begin COMPU_METHOD x280_canfd_loopback_CM_double "Q = V" IDENTICAL "%15.10" "" /end COMPU_METHOD
/begin COMPU_METHOD x280_canfd_loopback_CM_int32 "Q = V" IDENTICAL "%10.0" "" /end COMPU_METHOD
/begin COMPU_METHOD x280_canfd_loopback_CM_int_T "Q = V" IDENTICAL "%0.6" "" /end COMPU_METHOD
/begin COMPU_METHOD x280_canfd_loopback_CM_logical "Q = V" IDENTICAL "%1.0" "" /end COMPU_METHOD
/begin COMPU_METHOD x280_canfd_loopback_CM_uint32 "Q = V" IDENTICAL "%10.0" "" /end COMPU_METHOD
/begin COMPU_METHOD x280_canfd_loopback_CM_uint8 "Q = V" IDENTICAL "%3.0" "" /end COMPU_METHOD
/begin RECORD_LAYOUT Record_BOOLEAN FNC_VALUES 1 UBYTE COLUMN_DIR DIRECT /end RECORD_LAYOUT
/begin RECORD_LAYOUT Record_FLOAT64_IEEE FNC_VALUES 1 FLOAT64_IEEE COLUMN_DIR DIRECT /end RECORD_LAYOUT
/begin RECORD_LAYOUT Record_SLONG FNC_VALUES 1 SLONG COLUMN_DIR DIRECT /end RECORD_LAYOUT
/begin RECORD_LAYOUT Record_UBYTE FNC_VALUES 1 UBYTE COLUMN_DIR DIRECT /end RECORD_LAYOUT
/begin RECORD_LAYOUT Record_ULONG FNC_VALUES 1 ULONG COLUMN_DIR DIRECT /end RECORD_LAYOUT
/begin GROUP x280_canfd_loopback "x280_canfd_loopback" /* Root */ ROOT
 /begin SUB_GROUP x280_canfd_loopback_B.Pack_CAN1 x280_canfd_loopback_B.Pack_CAN2 x280_canfd_loopback_B.Receive_CAN1_o1 x280_canfd_loopback_B.Receive_CAN2_o1 /end SUB_GROUP
 /begin REF_CHARACTERISTIC x280_canfd_loopback_P.CAN1_Payload_Value x280_canfd_loopback_P.CAN2_Payload_Value x280_canfd_loopback_P.Transmit_Enable_Value /end REF_CHARACTERISTIC
 /begin REF_MEASUREMENT x280_canfd_loopback_B.CAN1_Data x280_canfd_loopback_B.CAN1_ID x280_canfd_loopback_B.CAN1_RxStatus x280_canfd_loopback_B.CAN1_TxStatus x280_canfd_loopback_B.CAN1_Valid x280_canfd_loopback_B.CAN2_Data x280_canfd_loopback_B.CAN2_ID x280_canfd_loopback_B.CAN2_RxStatus x280_canfd_loopback_B.CAN2_TxStatus x280_canfd_loopback_B.CAN2_Valid x280_canfd_loopback_DW.Unpack_CAN1_ModeSignalID x280_canfd_loopback_DW.Unpack_CAN1_StatusPortID x280_canfd_loopback_DW.Unpack_CAN2_ModeSignalID x280_canfd_loopback_DW.Unpack_CAN2_StatusPortID x280_canfd_loopback_Y.CAN1_Data x280_canfd_loopback_Y.CAN1_ID x280_canfd_loopback_Y.CAN1_RxStatus x280_canfd_loopback_Y.CAN1_TxStatus x280_canfd_loopback_Y.CAN1_Valid x280_canfd_loopback_Y.CAN2_Data x280_canfd_loopback_Y.CAN2_ID x280_canfd_loopback_Y.CAN2_RxStatus x280_canfd_loopback_Y.CAN2_TxStatus x280_canfd_loopback_Y.CAN2_Valid /end REF_MEASUREMENT
/end GROUP
/begin GROUP x280_canfd_loopback_B.Pack_CAN1 ""
 /begin REF_MEASUREMENT x280_canfd_loopback_B.Pack_CAN1.ProtocolMode x280_canfd_loopback_B.Pack_CAN1.Extended x280_canfd_loopback_B.Pack_CAN1.Length x280_canfd_loopback_B.Pack_CAN1.Remote x280_canfd_loopback_B.Pack_CAN1.Error x280_canfd_loopback_B.Pack_CAN1.BRS x280_canfd_loopback_B.Pack_CAN1.ESI x280_canfd_loopback_B.Pack_CAN1.DLC x280_canfd_loopback_B.Pack_CAN1.ID x280_canfd_loopback_B.Pack_CAN1.Reserved x280_canfd_loopback_B.Pack_CAN1.Timestamp x280_canfd_loopback_B.Pack_CAN1.Data /end REF_MEASUREMENT
/end GROUP
/begin GROUP x280_canfd_loopback_B.Pack_CAN2 ""
 /begin REF_MEASUREMENT x280_canfd_loopback_B.Pack_CAN2.ProtocolMode x280_canfd_loopback_B.Pack_CAN2.Extended x280_canfd_loopback_B.Pack_CAN2.Length x280_canfd_loopback_B.Pack_CAN2.Remote x280_canfd_loopback_B.Pack_CAN2.Error x280_canfd_loopback_B.Pack_CAN2.BRS x280_canfd_loopback_B.Pack_CAN2.ESI x280_canfd_loopback_B.Pack_CAN2.DLC x280_canfd_loopback_B.Pack_CAN2.ID x280_canfd_loopback_B.Pack_CAN2.Reserved x280_canfd_loopback_B.Pack_CAN2.Timestamp x280_canfd_loopback_B.Pack_CAN2.Data /end REF_MEASUREMENT
/end GROUP
/begin GROUP x280_canfd_loopback_B.Receive_CAN1_o1 ""
 /begin REF_MEASUREMENT x280_canfd_loopback_B.Receive_CAN1_o1.ProtocolMode x280_canfd_loopback_B.Receive_CAN1_o1.Extended x280_canfd_loopback_B.Receive_CAN1_o1.Length x280_canfd_loopback_B.Receive_CAN1_o1.Remote x280_canfd_loopback_B.Receive_CAN1_o1.Error x280_canfd_loopback_B.Receive_CAN1_o1.BRS x280_canfd_loopback_B.Receive_CAN1_o1.ESI x280_canfd_loopback_B.Receive_CAN1_o1.DLC x280_canfd_loopback_B.Receive_CAN1_o1.ID x280_canfd_loopback_B.Receive_CAN1_o1.Reserved x280_canfd_loopback_B.Receive_CAN1_o1.Timestamp x280_canfd_loopback_B.Receive_CAN1_o1.Data /end REF_MEASUREMENT
/end GROUP
/begin GROUP x280_canfd_loopback_B.Receive_CAN2_o1 ""
 /begin REF_MEASUREMENT x280_canfd_loopback_B.Receive_CAN2_o1.ProtocolMode x280_canfd_loopback_B.Receive_CAN2_o1.Extended x280_canfd_loopback_B.Receive_CAN2_o1.Length x280_canfd_loopback_B.Receive_CAN2_o1.Remote x280_canfd_loopback_B.Receive_CAN2_o1.Error x280_canfd_loopback_B.Receive_CAN2_o1.BRS x280_canfd_loopback_B.Receive_CAN2_o1.ESI x280_canfd_loopback_B.Receive_CAN2_o1.DLC x280_canfd_loopback_B.Receive_CAN2_o1.ID x280_canfd_loopback_B.Receive_CAN2_o1.Reserved x280_canfd_loopback_B.Receive_CAN2_o1.Timestamp x280_canfd_loopback_B.Receive_CAN2_o1.Data /end REF_MEASUREMENT
/end GROUP
/end MODULE
/end PROJECT
/* (add any file trailer comments here) */
/* EOF x280_canfd_loopback.a2l*/
