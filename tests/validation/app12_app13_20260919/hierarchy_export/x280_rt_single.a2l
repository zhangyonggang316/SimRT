/******************************************************************************
* ASAP2 file: x280_rt_single.a2l
* Academic License - for use in teaching, academic research, and meeting
* course requirements at degree granting institutions only. Not for
* government, commercial, or other organizational use.
* Code generation for model "x280_rt_single".
* Model version : 1.5
* Simulink Coder version : 24.2 (R2024b) 21-Jun-2024
* C source code generated on : Sat Sep 19 09:52:37 2026
* Target selection: ert.tlc
* Embedded hardware selection: Intel->x86-64 (Linux 64)
* Code generation objectives: Unspecified
* Validation result: Not run
* (add additional file header information here)
******************************************************************************/ ASAP2_VERSION 1 71
/* Version 1.71 */
/begin PROJECT ProjectName "Project Comment Goes Here"
/begin HEADER "Header Comments go here" /end HEADER
/begin MODULE ModuleName "Module Comment Goes Here"
/begin IF_DATA XCP
 /begin PROTOCOL_LAYER 0x0100 0x03E8 0x00C8 0x0000 0x0000 0x0000 0x0000 0x0000 0xFF 0x01FC BYTE_ORDER_MSB_LAST ADDRESS_GRANULARITY_BYTE OPTIONAL_CMD ALLOC_ODT_ENTRY OPTIONAL_CMD ALLOC_ODT OPTIONAL_CMD ALLOC_DAQ OPTIONAL_CMD FREE_DAQ OPTIONAL_CMD GET_DAQ_RESOLUTION_INFO OPTIONAL_CMD GET_DAQ_PROCESSOR_INFO OPTIONAL_CMD START_STOP_SYNCH OPTIONAL_CMD START_STOP_DAQ_LIST OPTIONAL_CMD SET_DAQ_LIST_MODE OPTIONAL_CMD WRITE_DAQ OPTIONAL_CMD SET_DAQ_PTR OPTIONAL_CMD SHORT_DOWNLOAD OPTIONAL_CMD DOWNLOAD OPTIONAL_CMD SHORT_UPLOAD OPTIONAL_CMD UPLOAD OPTIONAL_CMD SET_MTA /end PROTOCOL_LAYER
 /begin DAQ DYNAMIC 0xFFFF 0x0080 0x00 OPTIMISATION_TYPE_DEFAULT ADDRESS_EXTENSION_FREE IDENTIFICATION_FIELD_TYPE_ABSOLUTE GRANULARITY_ODT_ENTRY_SIZE_DAQ_BYTE 0xFF NO_OVERLOAD_INDICATION /begin TIMESTAMP_SUPPORTED 0x0001 SIZE_DWORD UNIT_1US /end TIMESTAMP_SUPPORTED /begin EVENT "1 ms" "1 ms" 0x0000 DAQ 0xFF 0x01 0x06 0x00 /end EVENT /end DAQ
 /begin XCP_ON_UDP_IP 0x0100 0x453D ADDRESS "192.168.219.86" /end XCP_ON_UDP_IP
/end IF_DATA
/begin MOD_PAR "MOD PAR Comment Goes Here" /end MOD_PAR
/begin MOD_COMMON "Mod Common Comment Here" BYTE_ORDER MSB_LAST ALIGNMENT_BYTE 1 ALIGNMENT_WORD 2 ALIGNMENT_LONG 4 ALIGNMENT_FLOAT32_IEEE 4 ALIGNMENT_FLOAT64_IEEE 8 ALIGNMENT_INT64 8 /end MOD_COMMON
/begin CHARACTERISTIC CalGain "" VALUE 0x004162A8 Record_FLOAT64_IEEE 0 x280_rt_single_CM_double 0.000000 20.000000 /end CHARACTERISTIC
/begin CHARACTERISTIC CalOffset "" VALUE 0x00416440 Record_FLOAT64_IEEE 0 x280_rt_single_CM_double -10.000000 10.000000 /end CHARACTERISTIC
/begin CHARACTERISTIC InputAmplitude "" VALUE 0x004162A0 Record_FLOAT64_IEEE 0 x280_rt_single_CM_double 0.000000 10.000000 /end CHARACTERISTIC
/begin CHARACTERISTIC OutputLowerLimit "" VALUE 0x00416298 Record_FLOAT64_IEEE 0 x280_rt_single_CM_double -100.000000 0.000000 /end CHARACTERISTIC
/begin CHARACTERISTIC OutputUpperLimit "" VALUE 0x00416290 Record_FLOAT64_IEEE 0 x280_rt_single_CM_double 0.000000 100.000000 /end CHARACTERISTIC
/begin CHARACTERISTIC x280_rt_single_P.Excitation_Bias "" VALUE 0x004162C0 Record_FLOAT64_IEEE 0 x280_rt_single_CM_double -1.7E+308 1.7E+308 /end CHARACTERISTIC
/begin CHARACTERISTIC x280_rt_single_P.Excitation_Freq "" VALUE 0x004162C8 Record_FLOAT64_IEEE 0 x280_rt_single_CM_double -1.7E+308 1.7E+308 /end CHARACTERISTIC
/begin CHARACTERISTIC x280_rt_single_P.Excitation_HCos "" VALUE 0x004162E0 Record_FLOAT64_IEEE 0 x280_rt_single_CM_double -1.7E+308 1.7E+308 /end CHARACTERISTIC
/begin CHARACTERISTIC x280_rt_single_P.Excitation_Hsin "" VALUE 0x004162D8 Record_FLOAT64_IEEE 0 x280_rt_single_CM_double -1.7E+308 1.7E+308 /end CHARACTERISTIC
/begin CHARACTERISTIC x280_rt_single_P.Excitation_PCos "" VALUE 0x004162F0 Record_FLOAT64_IEEE 0 x280_rt_single_CM_double -1.7E+308 1.7E+308 /end CHARACTERISTIC
/begin CHARACTERISTIC x280_rt_single_P.Excitation_PSin "" VALUE 0x004162E8 Record_FLOAT64_IEEE 0 x280_rt_single_CM_double -1.7E+308 1.7E+308 /end CHARACTERISTIC
/begin CHARACTERISTIC x280_rt_single_P.Excitation_Phase "" VALUE 0x004162D0 Record_FLOAT64_IEEE 0 x280_rt_single_CM_double -1.7E+308 1.7E+308 /end CHARACTERISTIC
/begin MEASUREMENT x280_rt_single_B.MeasuredBeforeLimits "" FLOAT64_IEEE x280_rt_single_CM_double 0 0 -1.7E+308 1.7E+308 ECU_ADDRESS 0x005178E0 /end MEASUREMENT
/begin MEASUREMENT x280_rt_single_B.MeasuredOutput "" FLOAT64_IEEE x280_rt_single_CM_double 0 0 -1.7E+308 1.7E+308 ECU_ADDRESS 0x005178E8 /end MEASUREMENT
/begin MEASUREMENT x280_rt_single_DW.lastCos "" FLOAT64_IEEE x280_rt_single_CM_double 0 0 -1.7E+308 1.7E+308 ECU_ADDRESS 0x005178C8 /end MEASUREMENT
/begin MEASUREMENT x280_rt_single_DW.lastSin "" FLOAT64_IEEE x280_rt_single_CM_double 0 0 -1.7E+308 1.7E+308 ECU_ADDRESS 0x005178C0 /end MEASUREMENT
/begin MEASUREMENT x280_rt_single_DW.systemEnable "" SLONG x280_rt_single_CM_int32 0 0 -2147483648 2147483647 ECU_ADDRESS 0x005178D0 /end MEASUREMENT
/begin MEASUREMENT x280_rt_single_Y.Measuredoutput "" FLOAT64_IEEE x280_rt_single_CM_double 0 0 -1.7E+308 1.7E+308 ECU_ADDRESS 0x005178F0 /end MEASUREMENT
/begin COMPU_METHOD /* Name of CompuMethod */ x280_rt_single_CM_double "Q = V" /* Conversion Type */ IDENTICAL /* Format */ "%15.10" /* Units */ "" /end COMPU_METHOD
/begin COMPU_METHOD /* Name of CompuMethod */ x280_rt_single_CM_int32 "Q = V" /* Conversion Type */ IDENTICAL /* Format */ "%10.0" /* Units */ "" /end COMPU_METHOD
/begin RECORD_LAYOUT Record_FLOAT64_IEEE FNC_VALUES 1 FLOAT64_IEEE COLUMN_DIR DIRECT /end RECORD_LAYOUT
/begin RECORD_LAYOUT Record_SLONG FNC_VALUES 1 SLONG COLUMN_DIR DIRECT /end RECORD_LAYOUT
/begin GROUP X280_ModelHierarchy_000001 "x280_rt_single" /* Root */ ROOT
 /begin REF_CHARACTERISTIC CalGain CalOffset InputAmplitude OutputLowerLimit OutputUpperLimit x280_rt_single_P.Excitation_Bias x280_rt_single_P.Excitation_Freq x280_rt_single_P.Excitation_HCos x280_rt_single_P.Excitation_Hsin x280_rt_single_P.Excitation_PCos x280_rt_single_P.Excitation_PSin x280_rt_single_P.Excitation_Phase /end REF_CHARACTERISTIC
 /begin REF_MEASUREMENT x280_rt_single_B.MeasuredBeforeLimits x280_rt_single_B.MeasuredOutput x280_rt_single_DW.lastCos x280_rt_single_DW.lastSin x280_rt_single_DW.systemEnable x280_rt_single_Y.Measuredoutput /end REF_MEASUREMENT
/end GROUP
/end MODULE
/end PROJECT
/* (add any file trailer comments here) */
/* EOF x280_rt_single.a2l*/
